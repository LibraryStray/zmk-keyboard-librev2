## boards/shields/librev2/Kconfig.defconfig
```kconfig
if SHIELD_LIBREV2_LEFT

# Name must be less than 16 characters long!
config ZMK_KEYBOARD_NAME
    default "librev2"

config ZMK_SPLIT_ROLE_CENTRAL
    default y

endif

if SHIELD_LIBREV2_LEFT || SHIELD_LIBREV2_RIGHT

config ZMK_SPLIT
    default y

endif
```

## boards/shields/librev2/Kconfig.shield
```kconfig
config SHIELD_LIBREV2_LEFT
    def_bool $(shields_list_contains,librev2_left)

config SHIELD_LIBREV2_RIGHT
    def_bool $(shields_list_contains,librev2_right)
```
